## main/Kconfig.projbuild
```kconfig
menu "OTA Test Example"
    menu "Application"
        menu "Module"
            menu "SIMCom Module"
                choice SIMCOM_MODULE_EXAMPLE_COMMUNICATION_MODULE
                    prompt "Select communication module"
                    default USE_Y70XX_SIMCOM_MODULE

                    config USE_Y70XX_SIMCOM_MODULE
                        bool "Y70XX"
                endchoice
            endmenu
        endmenu
    endmenu
endmenu
```

## sdkconfig.defaults
```kconfig
CONFIG_ESPTOOLPY_FLASHSIZE_4MB=y
CONFIG_ESPTOOLPY_FLASHSIZE="4MB"

CONFIG_PARTITION_TABLE_CUSTOM=y
CONFIG_PARTITION_TABLE_CUSTOM_FILENAME="partitions.csv"
CONFIG_PARTITION_TABLE_FILENAME="partitions.csv"

CONFIG_SECURE_SIGNED_ON_UPDATE=y
CONFIG_SECURE_SIGNED_APPS=y
CONFIG_SECURE_BOOT_V2_RSA_SUPPORTED=y
CONFIG_SECURE_BOOT_V2_PREFERRED=y
CONFIG_SECURE_SIGNED_APPS_NO_SECURE_BOOT=y
CONFIG_SECURE_SIGNED_APPS_RSA_SCHEME=y
CONFIG_SECURE_SIGNED_ON_UPDATE_NO_SECURE_BOOT=y
CONFIG_SECURE_BOOT_BUILD_SIGNED_BINARIES=n

CONFIG_INCLUDE_ESP_LOG=y

CONFIG_INCLUDE_ESP_GPIO=y
CONFIG_INCLUDE_ESP_USART=y
CONFIG_INCLUDE_ESP_NVS=y

CONFIG_INCLUDE_Y70XX=y
```
